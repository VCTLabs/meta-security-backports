## conf/layer.conf
```bitbake
# We have a conf and classes directory, add to BBPATH
BBPATH .= ":${LAYERDIR}"

# We have recipes-* directories, add to BBFILES
BBFILES += "${LAYERDIR}/recipes-*/*/*.bb \
	${LAYERDIR}/recipes-*/*/*.bbappend"

BBFILE_COLLECTIONS += "security-backports"
BBFILE_PATTERN_security-backports = "^${LAYERDIR}/"
BBFILE_PRIORITY_security-backports = "10"

LAYERSERIES_COMPAT_security-backports = "zeus dunfell"

LAYERDEPENDS_security-backports = "core openembedded-layer"

QB_KERNEL_CMDLINE_APPEND = " ${@bb.utils.contains('DISTRO_FEATURES', 'apparmor', 'apparmor=1 security=apparmor', '', d)}"
```
